#ifndef MOCHI_FACES_H
#define MOCHI_FACES_H

#include <stdint.h>
#include <stddef.h>
#include <stdbool.h>

#ifdef ARDUINO
#include <Arduino.h>
#include <U8g2lib.h>
#endif

// =========================================================================
// AUTHENTIC DASAI MOCHI FACIAL BITMAPS (Clean, Symmetrical Vectorized Grid)
// =========================================================================
#define MOCHI_EYE_CAPSULE_W 20
#define MOCHI_EYE_CAPSULE_H 22
static const uint8_t mochi_eye_capsule[] = {
    0x03, 0xFC, 0x00, 0x0F, 0xFF, 0x00, 0x1F, 0xFF, 0x80, 0x3F, 0xFF, 0xC0,
    0x39, 0xFF, 0xC0, 0x79, 0xFF, 0xE0, 0x7F, 0xFF, 0xE0, 0x7F, 0xFF, 0xE0,
    0x7F, 0xFF, 0xE0, 0x7F, 0xFF, 0xE0, 0x7F, 0xFF, 0xE0, 0x7F, 0xFF, 0xE0,
    0x7F, 0xFF, 0xE0, 0x7F, 0xFF, 0xE0, 0x7F, 0xFF, 0xE0, 0x7F, 0xFF, 0xE0,
    0x7F, 0xFF, 0xE0, 0x7F, 0xFF, 0xE0, 0x3F, 0xFF, 0xC0, 0x1F, 0xFF, 0x80,
    0x0F, 0xFF, 0x00, 0x03, 0xFC, 0x00,
};

#define MOCHI_EYE_BLINK_HALF_W 20
#define MOCHI_EYE_BLINK_HALF_H 10
static const uint8_t mochi_eye_blink_half[] = {
    0x03, 0xFC, 0x00, 0x0F, 0xFF, 0x00, 0x3F, 0xFF, 0xC0, 0x7F, 0xFF, 0xE0,
    0x7F, 0xFF, 0xE0, 0x7F, 0xFF, 0xE0, 0x7F, 0xFF, 0xE0, 0x3F, 0xFF, 0xC0,
    0x0F, 0xFF, 0x00, 0x03, 0xFC, 0x00,
};

#define MOCHI_EYE_BLINK_SLIT_W 20
#define MOCHI_EYE_BLINK_SLIT_H 4
static const uint8_t mochi_eye_blink_slit[] = {
    0x7F, 0xFF, 0xE0, 0xFF, 0xFF, 0xF0, 0xFF, 0xFF, 0xF0, 0x7F, 0xFF, 0xE0,
};

#define MOCHI_MOUTH_RESTING_W 14
#define MOCHI_MOUTH_RESTING_H 4
static const uint8_t mochi_mouth_resting[] = {
    0x3F, 0xF0, 0x7F, 0xF8, 0x7F, 0xF8, 0x3F, 0xF0,
};

#define MOCHI_EYE_HAPPY_L_W 20
#define MOCHI_EYE_HAPPY_L_H 12
static const uint8_t mochi_eye_happy_l[] = {
    0x00, 0x7E, 0x00, 0x01, 0xFF, 0x80, 0x07, 0xFF, 0xE0, 0x1F, 0xFF, 0xF0,
    0x3F, 0x01, 0xF0, 0x78, 0x00, 0x30, 0xF0, 0x00, 0x10, 0xE0, 0x00, 0x00,
    0xC0, 0x00, 0x00, 0x80, 0x00, 0x00, 0x00, 0x00, 0x00, 0x00, 0x00, 0x00,
};

#define MOCHI_EYE_HAPPY_R_W 20
#define MOCHI_EYE_HAPPY_R_H 12
static const uint8_t mochi_eye_happy_r[] = {
    0x07, 0xE0, 0x00, 0x1F, 0xF8, 0x00, 0x7F, 0xFE, 0x00, 0xFF, 0xFF, 0x80,
    0xF8, 0x0F, 0xC0, 0xC0, 0x01, 0xE0, 0x80, 0x00, 0xF0, 0x00, 0x00, 0x70,
    0x00, 0x00, 0x30, 0x00, 0x00, 0x10, 0x00, 0x00, 0x00, 0x00, 0x00, 0x00,
};

#define MOCHI_MOUTH_HAPPY_W 16
#define MOCHI_MOUTH_HAPPY_H 7
static const uint8_t mochi_mouth_happy[] = {
    0x80, 0x01, 0xE0, 0x07, 0xF8, 0x1F, 0x7F, 0xFE, 0x3F, 0xFC, 0x1F, 0xF8,
    0x07, 0xE0,
};

#define MOCHI_EYE_LAUGH_L_W 20
#define MOCHI_EYE_LAUGH_L_H 16
static const uint8_t mochi_eye_laugh_l[] = {
    0xF0, 0x00, 0x00, 0x7C, 0x00, 0x00, 0x3F, 0x00, 0x00, 0x1F, 0xC0, 0x00,
    0x0F, 0xF0, 0x00, 0x07, 0xFC, 0x00, 0x03, 0xFF, 0x00, 0x01, 0xFF, 0xC0,
    0x00, 0xFF, 0xF0, 0x01, 0xFF, 0xC0, 0x03, 0xFF, 0x00, 0x07, 0xFC, 0x00,
    0x0F, 0xF0, 0x00, 0x1F, 0xC0, 0x00, 0x3F, 0x00, 0x00, 0x7C, 0x00, 0x00,
};

#define MOCHI_EYE_LAUGH_R_W 20
#define MOCHI_EYE_LAUGH_R_H 16
static const uint8_t mochi_eye_laugh_r[] = {
    0x00, 0x00, 0xF0, 0x00, 0x03, 0xE0, 0x00, 0x0F, 0xC0, 0x00, 0x3F, 0x80,
    0x00, 0xFF, 0x00, 0x03, 0xFE, 0x00, 0x0F, 0xFC, 0x00, 0x3F, 0xF8, 0x00,
    0xFF, 0xF0, 0x00, 0x3F, 0xF8, 0x00, 0x0F, 0xFC, 0x00, 0x03, 0xFE, 0x00,
    0x00, 0xFF, 0x00, 0x00, 0x3F, 0x80, 0x00, 0x0F, 0xC0, 0x00, 0x03, 0xE0,
};

#define MOCHI_MOUTH_LAUGH_W 20
#define MOCHI_MOUTH_LAUGH_H 10
static const uint8_t mochi_mouth_laugh[] = {
    0x80, 0x00, 0x10, 0xE0, 0x00, 0x70, 0xF8, 0x01, 0xF0, 0xFE, 0x07, 0xF0,
    0x7F, 0xFF, 0xE0, 0x3F, 0xFF, 0xC0, 0x1F, 0xFF, 0x80, 0x0F, 0xFF, 0x00,
    0x03, 0xFC, 0x00, 0x00, 0xF0, 0x00,
};

#define MOCHI_EYE_LOVE_W 20
#define MOCHI_EYE_LOVE_H 16
static const uint8_t mochi_eye_love[] = {
    0x3E, 0x0F, 0x80, 0x7F, 0x1F, 0xC0, 0xFF, 0xBF, 0xE0, 0xFF, 0xFF, 0xF0,
    0xFF, 0xFF, 0xF0, 0xFF, 0xFF, 0xF0, 0x7F, 0xFF, 0xE0, 0x3F, 0xFF, 0xC0,
    0x1F, 0xFF, 0x80, 0x0F, 0xFF, 0x00, 0x07, 0xFE, 0x00, 0x03, 0xFC, 0x00,
    0x01, 0xF8, 0x00, 0x00, 0xF0, 0x00, 0x00, 0x60, 0x00, 0x00, 0x00, 0x00,
};

#define MOCHI_EYE_ANGRY_L_W 20
#define MOCHI_EYE_ANGRY_L_H 16
static const uint8_t mochi_eye_angry_l[] = {
    0xFF, 0xFF, 0x00, 0x7F, 0xFF, 0x80, 0x3F, 0xFF, 0xC0, 0x1F, 0xFF, 0xE0,
    0x0F, 0xFF, 0xF0, 0x07, 0xFF, 0xF0, 0x03, 0xFF, 0xF0, 0x01, 0xFF, 0xF0,
    0x00, 0xFF, 0xF0, 0x00, 0x7F, 0xF0, 0x00, 0x3F, 0xF0, 0x00, 0x1F, 0xF0,
    0x00, 0x0F, 0xF0, 0x00, 0x07, 0xF0, 0x00, 0x03, 0xF0, 0x00, 0x01, 0xF0,
};

#define MOCHI_EYE_ANGRY_R_W 20
#define MOCHI_EYE_ANGRY_R_H 16
static const uint8_t mochi_eye_angry_r[] = {
    0x0F, 0xFF, 0xF0, 0x1F, 0xFF, 0xE0, 0x3F, 0xFF, 0xC0, 0x7F, 0xFF, 0x80,
    0xFF, 0xFF, 0x00, 0xFF, 0xFE, 0x00, 0xFF, 0xFC, 0x00, 0xFF, 0xF8, 0x00,
    0xFF, 0xF0, 0x00, 0xFF, 0xE0, 0x00, 0xFF, 0xC0, 0x00, 0xFF, 0x80, 0x00,
    0xFF, 0x00, 0x00, 0xFE, 0x00, 0x00, 0xFC, 0x00, 0x00, 0xF8, 0x00, 0x00,
};

#define MOCHI_MOUTH_ANGRY_W 14
#define MOCHI_MOUTH_ANGRY_H 5
static const uint8_t mochi_mouth_angry[] = {
    0xFF, 0xFC, 0xFF, 0xFC, 0x7F, 0xF8, 0x3F, 0xF0, 0x0F, 0xC0,
};

#define MOCHI_EYE_SLEEPY_W 20
#define MOCHI_EYE_SLEEPY_H 6
static const uint8_t mochi_eye_sleepy[] = {
    0x80, 0x00, 0x10, 0xC0, 0x00, 0x30, 0xE0, 0x00, 0x70, 0x7C, 0x03, 0xE0,
    0x3F, 0xFF, 0xC0, 0x0F, 0xFF, 0x00,
};

#define MOCHI_MOUTH_YAWN_W 14
#define MOCHI_MOUTH_YAWN_H 10
static const uint8_t mochi_mouth_yawn[] = {
    0x0F, 0xC0, 0x3F, 0xF0, 0x7F, 0xF8, 0xFF, 0xFC, 0xFF, 0xFC, 0xFF, 0xFC,
    0xFF, 0xFC, 0x7F, 0xF8, 0x3F, 0xF0, 0x0F, 0xC0,
};

#define MOCHI_EYE_DIZZY_W 20
#define MOCHI_EYE_DIZZY_H 20
static const uint8_t mochi_eye_dizzy[] = {
    0x03, 0xFC, 0x00, 0x0F, 0xFF, 0x00, 0x1F, 0xFF, 0x80, 0x3F, 0xFF, 0xC0,
    0x7C, 0x03, 0xE0, 0x78, 0xF1, 0xE0, 0xF1, 0xF8, 0xF0, 0xE3, 0xFC, 0x70,
    0xE3, 0x0C, 0x70, 0xE3, 0x6C, 0x70, 0xE3, 0x6C, 0x70, 0xE3, 0x7C, 0x70,
    0xE3, 0x00, 0x70, 0xE3, 0xFF, 0x70, 0xF1, 0xFE, 0xF0, 0x78, 0xFD, 0xE0,
    0x7C, 0x03, 0xE0, 0x3F, 0xFF, 0xC0, 0x1F, 0xFF, 0x80, 0x0F, 0xFF, 0x00,
};

#define MOCHI_EYE_SURPRISED_W 22
#define MOCHI_EYE_SURPRISED_H 22
static const uint8_t mochi_eye_surprised[] = {
    0x01, 0xFE, 0x00, 0x07, 0xFF, 0x80, 0x1F, 0xFF, 0xE0, 0x3F, 0xFF, 0xF0,
    0x7F, 0xFF, 0xF8, 0x7F, 0xFF, 0xF8, 0xFF, 0xFF, 0xFC, 0xFF, 0xFF, 0xFC,
    0xFF, 0xFF, 0xFC, 0xFF, 0xFF, 0xFC, 0xFF, 0xFF, 0xFC, 0xFF, 0xFF, 0xFC,
    0xFF, 0xFF, 0xFC, 0xFF, 0xFF, 0xFC, 0xFF, 0xFF, 0xFC, 0xFF, 0xFF, 0xFC,
    0x7F, 0xFF, 0xF8, 0x7F, 0xFF, 0xF8, 0x3F, 0xFF, 0xF0, 0x1F, 0xFF, 0xE0,
    0x07, 0xFF, 0x80, 0x01, 0xFE, 0x00,
};

#define MOCHI_MOUTH_SURPRISED_W 12
#define MOCHI_MOUTH_SURPRISED_H 10
static const uint8_t mochi_mouth_surprised[] = {
    0x1F, 0x80, 0x3F, 0xC0, 0x7F, 0xE0, 0xFF, 0xF0, 0xFF, 0xF0, 0xFF, 0xF0,
    0xFF, 0xF0, 0x7F, 0xE0, 0x3F, 0xC0, 0x1F, 0x80,
};

// =========================================================================
// FAST HIGH-PERFORMANCE BITMAP BLITTER (Host & Arduino Compatible)
// =========================================================================
static inline void mochi_blit_mono(uint8_t* buffer, int buf_w, int buf_h, int dst_x, int dst_y, int w, int h, const uint8_t* bmp, bool invert = false) {
    if (!buffer || !bmp) return;
    int row_bytes = (w + 7) / 8;
    for (int y = 0; y < h; y++) {
        int py = dst_y + y;
        if (py < 0 || py >= buf_h) continue;
        for (int x = 0; x < w; x++) {
            int px = dst_x + x;
            if (px < 0 || px >= buf_w) continue;
            int byte_idx = y * row_bytes + (x / 8);
            int bit_idx = 7 - (x % 8);
            bool pixel = (bmp[byte_idx] >> bit_idx) & 1;
            if (invert) pixel = !pixel;
            if (pixel) {
                buffer[py * (buf_w / 8) + (px / 8)] |= (1 << (7 - (px % 8)));
            }
        }
    }
}

#ifdef ARDUINO
static inline void mochi_draw_u8g2(U8G2& display, int dst_x, int dst_y, int w, int h, const uint8_t* bmp) {
    if (!bmp) return;
    int row_bytes = (w + 7) / 8;
    for (int y = 0; y < h; y++) {
        int py = dst_y + y;
        if (py < 0 || py >= 64) continue;
        for (int x = 0; x < w; x++) {
            int px = dst_x + x;
            if (px < 0 || px >= 128) continue;
            int byte_idx = y * row_bytes + (x / 8);
            int bit_idx = 7 - (x % 8);
            if ((bmp[byte_idx] >> bit_idx) & 1) {
                display.drawPixel(px, py);
            }
        }
    }
}
#endif

#endif // MOCHI_FACES_H
